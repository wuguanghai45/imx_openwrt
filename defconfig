## defconfig
```kconfig
CONFIG_TARGET_imx=y
CONFIG_TARGET_imx_cortexa55=y
CONFIG_TARGET_imx_cortexa55_DEVICE_imx9352sd=y
CONFIG_PACKAGE_atf-imx93evk=m
CONFIG_DEVEL=y
CONFIG_KERNEL_GIT_CLONE_URI="https://github.com/nxp-imx/linux-imx.git"
CONFIG_KERNEL_GIT_LOCAL_REPOSITORY=""
CONFIG_KERNEL_GIT_MIRROR_HASH="6624aa88787972004e4c55e0f5820898cd3e325e340bf464d1e93e82b5fe7753"
CONFIG_KERNEL_GIT_REF="lf-6.6.52-2.2.0"
CONFIG_PACKAGE_i2c-tools=y
```
